## boards/shields/eyelash_sofle/Kconfig.defconfig
```kconfig
if SHIELD_EYELASH_SOFLE_CENTRAL_DONGLE

config ZMK_KEYBOARD_NAME
    default "Eyelash Sofle"

config ZMK_SPLIT_ROLE_CENTRAL
    default n

endif


if SHIELD_EYELASH_SOFLE_CENTRAL_DONGLE || SHIELD_EYELASH_SOFLE_PERIPHERAL_LEFT || SHIELD_EYELASH_SOFLE_PERIPHERAL_RIGHT || SHIELD_EYELASH_SOFLE_CENTRAL_LEFT

config ZMK_SPLIT
    default y


if ZMK_DISPLAY

config I2C
    default y

config SSD1306
    default y

choice ZMK_DISPLAY_WORK_QUEUE
    default ZMK_DISPLAY_WORK_QUEUE_DEDICATED
endchoice

endif

if SSD1306

config LV_Z_VDB_SIZE
    default 64

config LV_DPI_DEF
    default 148

config LV_Z_BITS_PER_PIXEL
    default 1

choice LV_COLOR_DEPTH
    default LV_COLOR_DEPTH_1
endchoice

endif

if ZMK_BACKLIGHT

config PWM
    default y

config LED_PWM
    default y

endif # ZMK_BACKLIGHT

endif
```

## boards/shields/eyelash_sofle/Kconfig.shield
```kconfig
# Copyright (c) 2020 The ZMK Contributors
# SPDX-License-Identifier: MIT

config SHIELD_EYELASH_SOFLE_CENTRAL_DONGLE
    def_bool $(shields_list_contains,eyelash_sofle_central_dongle)

config SHIELD_EYELASH_SOFLE_PERIPHERAL_LEFT
    def_bool $(shields_list_contains,eyelash_sofle_peripheral_left)

config SHIELD_EYELASH_SOFLE_PERIPHERAL_RIGHT
    def_bool $(shields_list_contains,eyelash_sofle_peripheral_right)

config SHIELD_EYELASH_SOFLE_CENTRAL_LEFT
    def_bool $(shields_list_contains,eyelash_sofle_central_left)
```

## config/west.yml
```yaml
manifest:
  remotes:
    - name: zmkfirmware
      url-base: https://github.com/zmkfirmware
    - name: gpeye
      url-base: https://github.com/GPeye
    - name: englmaxi
      url-base: https://github.com/englmaxi
    - name: M165437
      url-base: https://github.com/M165437

    - name: mctechnology17
      url-base: https://github.com/mctechnology17
  projects:
    - name: zmk
      remote: zmkfirmware
      revision: v0.3
      import: app/west.yml
    - name: zmk-dongle-display
      remote: englmaxi
      revision: v0.3
    - name: nice-view-gem
      remote: M165437
      revision: v0.3.0
    - name: zmk-nice-oled
      remote: mctechnology17
      revision: main
    - name: hammerbeam-slideshow
      remote: gpeye
      revision: main
  self:
    path: config
```
